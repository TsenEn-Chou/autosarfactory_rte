AUTOSAR XML (schema 00049)
standard types defined: uint8, Float64, float64
package /ControlSWC_Datatypes/ImplementationDataTypes
  impl type TYP_ExchangedData_uint8: category=VALUE, type-emitter=RTE, base-type=uint8
  impl type TYP_ExchangedData_float64: category=VALUE, base-type=Float64
