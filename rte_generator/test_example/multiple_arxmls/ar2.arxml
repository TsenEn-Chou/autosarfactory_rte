AUTOSAR XML (schema 00049)
standard types defined: uint16
package /ObservationSWC_Datatypes/ImplementationDataTypes
  impl type TYP_ExchangedData_uint16: category=VALUE, base-type=uint16
  impl type TYP_ExchangedData_float64: category=VALUE, type-emitter=RTE, base-type=Float64
