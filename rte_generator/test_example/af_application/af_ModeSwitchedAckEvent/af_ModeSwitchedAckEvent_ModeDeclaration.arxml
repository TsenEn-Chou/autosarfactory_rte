AUTOSAR XML (schema 00049)
package /af_EvMsa_ModeDeclaration
  mode declaration group ECUMMode: category=EXPLICIT_ORDER, initial-mode=STARTUP_SHUTDOWN, on-transition-value=666
    mode STARTUP_SHUTDOWN: value=100
    mode RUN: value=101
    mode SLEEP: value=1000
