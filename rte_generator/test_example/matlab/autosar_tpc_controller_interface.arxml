AUTOSAR XML (schema 4-3-1)
package /TPC_Composition/Interfaces
  sender receiver interface TPS_Percent
    data Value: category=VALUE, sw-calibration-access=READ-ONLY, type=Float
  sender receiver interface APP_Percent
    data Value: category=VALUE, sw-calibration-access=READ-ONLY, type=Float
  sender receiver interface ThrCmd_Percent
    data Value: category=VALUE, sw-calibration-access=READ-ONLY, type=Float
