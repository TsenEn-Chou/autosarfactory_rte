AUTOSAR XML (schema 4-3-1)
standard types defined: Float, float32
package /TPC_Composition/DataTypes/SwAddrMethods
  sw addr method CODE: section-type=CODE
  sw addr method CONST: section-type=CONST
  sw addr method VAR: section-type=VAR
