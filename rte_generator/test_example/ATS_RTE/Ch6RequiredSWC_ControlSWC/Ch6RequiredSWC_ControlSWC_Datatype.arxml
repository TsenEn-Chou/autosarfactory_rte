AUTOSAR XML (schema 00049)
standard types defined: uint8, Float64
package /ControlSWC_Datatypes/ImplementationDataTypes
  impl type TYP_ExchangedData_uint8: category=VALUE, type-emitter=RTE, base-type=uint8
    symbol props TYP_ExchangedData_uint8_symbol: symbol=MyUint8OfVendorID
  impl type TYP_ExchangedData_float64: category=VALUE, type-emitter=sssssssssss.h, base-type=Float64
    symbol props TYP_ExchangedData_float64_symbol: symbol=MyUint8OfVendorID
  impl type TYP_ExchangedData_float32: category=VALUE, type-emitter=RTE
