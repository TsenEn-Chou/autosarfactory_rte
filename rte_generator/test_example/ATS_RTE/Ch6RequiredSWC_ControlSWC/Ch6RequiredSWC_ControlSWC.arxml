AUTOSAR XML (schema 00049)
standard types defined: uint8, uint16
package /ControlSWC_Config/Types/ImplementationDataTypes
  impl type TYP_ExchangedData8: category=VALUE, base-type=uint8
  impl type TYP_ExchangedData16: category=VALUE, base-type=uint16
