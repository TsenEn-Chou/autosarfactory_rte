AUTOSAR XML (schema 00049)
standard types defined: uint8, Float64
package /ControlSWC_Datatypes/ImplementationDataTypes
  impl type SchM_TYP_ExchangedData_uint8: category=VALUE, base-type=uint8
    symbol props TYP_ExchangedData_uint8_symbol: symbol=SchM_MyUint8OfVendorID
  impl type TYP_ExchangedData_float64: category=VALUE, type-emitter=RTE, base-type=Float64
